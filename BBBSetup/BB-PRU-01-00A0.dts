/dts-v1/;
/plugin/;

/ {
   compatible = "ti,beaglebone", "ti,beaglebone-black";

   part-number = "BB-PRU-01";
   version = "00A0";

   /* This overlay uses the following resources */
   exclusive-use =
          "P8.27", "P8.28", "P8.29", "P8.39", "P8.40", "P8.41", "P8.42", "P8.43", "P8.44", "P8.45", "P8.46", "pru0", "pru1";

   fragment@0 {
      target = <&am33xx_pinmux>;
      __overlay__ {

         pru_pru_pins: pinmux_pru_pru_pins {   // The PRU pin modes
            pinctrl-single,pins = <
                0x0e0 0x06 /* P8_27 pr1_pru1_pru_r31_8,   MODE6 | INPUT | 0000110 */
                0x0e8 0x06 /* P8_28 pr1_pru1_pru_r31_10,  MODE6 | INPUT | 0000110 */
                0x0e4 0x06 /* P8_29 pr1_pru1_pru_r31_9,   MODE6 | INPUT | 0000110 */
                0x0b8 0x06 /* P8_39 pr1_pru1_pru_r31_6,   MODE6 | INPUT | 0000110 */
                0x0bc 0x06 /* P8_40 pr1_pru1_pru_r31_7,   MODE6 | INPUT | 0000110 */
                0x0b0 0x06 /* P8_41 pr1_pru1_pru_r31_4,   MODE6 | INPUT | 0000110 */
                0x0b4 0x06 /* P8_42 pr1_pru1_pru_r31_5,   MODE6 | INPUT | 0000110 */
                0x0a8 0x06 /* P8_43 pr1_pru1_pru_r31_2,   MODE6 | INPUT | 0000110 */
                0x0ac 0x06 /* P8_44 pr1_pru1_pru_r31_3,   MODE6 | INPUT | 0000110 */
                0x0a0 0x06 /* P8_45 pr1_pru1_pru_r31_0,   MODE6 | INPUT | 0000110 */
                0x0a4 0x06 /* P8_46 pr1_pru1_pru_r31_1,   MODE6 | INPUT | 0000110 */
            >;
         };
      };
   };

   fragment@1 {         // Enable the PRUSS
      target = <&pruss>;
      __overlay__ {
         status = "okay";
         pinctrl-names = "default";
         pinctrl-0 = <&pru_pru_pins>;
      };
   };

};
